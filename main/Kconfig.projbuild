## main/Kconfig.projbuild
```kconfig
menu "TractorKit Peripheral"
    choice
        prompt "Device kind"
        help
            The kind of peripheral. Set to custom for new designs.

        config TK_ENGINESENSE
            bool "EngineSense"
        config TK_NAVIS
            bool "Navis"
        config TK_CUSTOM
            bool "Custom"
    endchoice

    config TK_DEVICE_NAME
        string "Device name" if TK_CUSTOM
        default "EngineSense" if TK_ENGINESENSE
        default "Navis" if TK_NAVIS
        default "Custom peripheral"
        help
            Sets the base device name.

    config TK_CURRENT_SENSOR_ENABLE
        bool "Enable current sensor"
        default n
        help
            Enables the current sensor. Set to no if there is no current sensor onboard.

    config TK_ADC2_CH7_IS_GPIO
        bool "SAR ADC 2 channel 7 is a GPIO"
        depends on TK_ENGINESENSE
        default n
        help
            If this channel has a voltage divider, this should be set to no,
            meaning that this channel is used as an ADC input.
            If set to yes, its pin will be used as GPIO 27.

    config TK_ADC2_CH9_IS_GPIO
        bool "SAR ADC 2 channel 9 is a GPIO"
        depends on TK_ENGINESENSE
        default n
        help
            If this channel has a voltage divider, this should be set to no,
            meaning that this channel is used as an ADC input.
            If set to yes, its pin will be used as GPIO 26.


    menu "GPS"
        depends on TK_NAVIS || TK_CUSTOM
        config TK_GPS_ENABLE
            bool "Enable GPS"
            default y if TK_NAVIS
            default n
            help
                Enables the connection with the GPS.

        config TK_GPS_RX_GPIO
            int "GPS RX GPIO"
            range 0 39
            depends on TK_GPS_ENABLE
            default 16
            help
                GPS port RX pin.

        config TK_GPS_TX_GPIO
            int "GPS TX GPIO"
            range 0 39
            depends on TK_GPS_ENABLE
            default 17
            help
                GPS port TX pin.

        config TK_GPS_INITIAL_BAUDRATE
            int "GPS initial baudrate"
            range 2400 921600
            depends on TK_GPS_ENABLE
            default 9600
            help
                GPS port RX pin.

        config TK_GPS_TARGET_BAUDRATE
            int "GPS target baudrate"
            range 2400 921600
            depends on TK_GPS_ENABLE
            default 115200
            help
                GPS port RX pin.

        menu "NMEA parser configuration"
            depends on TK_GPS_ENABLE
        
            config NMEA_PARSER_RING_BUFFER_SIZE
                int "NMEA Parser Ring Buffer Size"
                range 0 2048
                default 1024
                help
                    Size of the ring buffer used for UART Rx channel.
        
            config NMEA_PARSER_TASK_STACK_SIZE
                int "NMEA Parser Task Stack Size"
                range 0 4096
                default 2048
                help
                    Stack size of NMEA Parser task.
        
            config NMEA_PARSER_TASK_PRIORITY
                int "NMEA Parser Task Priority"
                range 0 24
                default 2
                help
                    Priority of NMEA Parser task.
        
            menu "NMEA Statement Support"
                comment "At least one statement must be selected"
                config NMEA_STATEMENT_GGA
                    bool "GGA Statement"
                    default y
                    help
                        Enabling this option will parse the following parameter from GGA statement:
        
                        - Latitude, Longitude, Altitude;
                        - Number of satellites in use, fix status (no fix, GPS, DGPS), UTC time;
        
                config NMEA_STATEMENT_GSA
                    bool "GSA Statement"
                    default y
                    help
                        Enabling this option will parse the following parameter from GSA statement:
        
                        - Position/Vertical/Horizontal dilution of precision;
                        - Fix mode (no fix, 2D, 3D fix);
                        - IDs of satellites in use;
        
                config NMEA_STATEMENT_GSV
                    bool "GSV Statement"
                    default y
                    help
                        Enabling this option will parse the following parameter from GSV statement:
        
                        - Number of satellites in view;
                        - Optional details of each satellite in view;
        
                config NMEA_STATEMENT_RMC
                    bool "RMC Statement"
                    default y
                    help
                        Enabling this option will parse the following parameter from RMC statement:
        
                        - Validity of GPS signal;
                        - Ground speed (knots) and course over ground (degrees);
                        - Magnetic variation;
                        - UTC date;
        
                config NMEA_STATEMENT_GLL
                    bool "GLL Statement"
                    default y
                    help
                        Enabling this option will parse the following parameter from GLL statement:
        
                        - Latitude, Longitude;
                        - UTC time;
        
                config NMEA_STATEMENT_VTG
                    bool "VTG Statement"
                    default y
                    help
                        Enabling this option will parse the following parameter from VTG statement:
        
                        - Ground speed (knots, km/h) and course over ground (degrees);
                        - Magnetic variation;
        
            endmenu
        
        endmenu

    endmenu

    menu "Engine"
        depends on TK_ENGINESENSE || TK_CUSTOM
        config TK_ENGINE_RPM_ENABLE
            bool "Enable RPM sensor"
            default y if TK_ENGINESENSE
            default n
            help
                Enables the RPM sensor.

        config TK_ENGINE_RPM_GPIO
            int "RPM sensor GPIO"
            range 0 39
            depends on TK_ENGINE_RPM_ENABLE
            default 25 if TK_ENGINE_RPM_ENABLE
            default 0
            help
                Sets the default GPIO for the RPM sensor's pulse output.

        config TK_ENGINE_RPM_DEBOUNCE_US
            int "RPM pulse debounce time (in us)"
            range 100 10000
            depends on TK_ENGINE_RPM_ENABLE
            default 2000
            help
                The debounce time for the pulse interrupt.
                Useful for filtering hall sensor instability when magnet is moving.
            
        config TK_ENGINE_RPM_MAX_PERIOD
            int "Maximum pulse period (in ms)"
            range 100 100000
            depends on TK_ENGINE_RPM_ENABLE
            default 1000
            help
                If the interrupt doesn't get called within this maximum period,
                data will become not available because the frequency is too low.
                Used when the frequency is too low for a simple threshold.

        config TK_ENGINE_THERM_ENABLE
            bool "Enable engine I2C temperature sensor"
            default y if TK_ENGINESENSE
            default n
            help
                Enables the I2C IR temperature sensor.

        choice TK_ENGINE_THERM_MODEL
            prompt "Device kind"
            depends on TK_ENGINE_THERM_ENABLE
            default TK_ENGINE_THERM_MELEXIS_MLX90614
            help
                The thermometer model.

            config TK_ENGINE_THERM_MELEXIS_MLX90614
                bool "Melexis MLX90614"
        endchoice
    endmenu

    menu "Onboard LED"
        visible if TK_CUSTOM
        config TK_ONBOARD_LED_ENABLE
            bool "Enable onboard LED"
            default y if TK_ENGINESENSE || TK_NAVIS
            default n
            help
                Enables the onboard LED. Set to no if there is no LED on the board.

        config TK_ONBOARD_LED_GPIO
            int "Onboard LED GPIO"
            range 0 39
            depends on TK_ONBOARD_LED_ENABLE
            default 23 if TK_ENGINESENSE
            default 25 if TK_NAVIS
            default 0
            help
                Sets the onboard LED's GPIO number.
    endmenu
endmenu
```
